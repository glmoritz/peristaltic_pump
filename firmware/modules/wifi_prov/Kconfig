## firmware/modules/wifi_prov/Kconfig
```kconfig
config WIFI_PROV
	bool "Wi-Fi provisioning module"
	select WIFI
	select NET_MGMT
	select NET_MGMT_EVENT
	select NET_L2_WIFI_MGMT
	select NET_SOCKETS
	select NET_DHCPV4_SERVER
	select FLASH
	select FLASH_MAP
	select NVS
	help
	  Wi-Fi station with stored credentials, and a captive portal on a
	  temporary access point to enter them. Derived from hello_eink.

if WIFI_PROV

config WIFI_PROV_NAME
	string "Device name in the portal and the AP SSID prefix"
	default "Device"

config WIFI_PROV_AP_TIMEOUT_S
	int "Portal timeout when credentials exist (s, 0 = never)"
	default 300
	help
	  When stored credentials fail (the router is still booting after a
	  power cut, say), the portal opens for this long and then the
	  station is tried again, forever. Without stored credentials the
	  portal stays open until it gets some.

endif
```

## firmware/modules/wifi_prov_sim/Kconfig
```kconfig
config WIFI_PROV
	bool "Wi-Fi provisioning (native_sim stub)"
	default y
	help
	  Stub for native_sim, where the network is the host's (offloaded
	  sockets): wifi_prov_start() announces CONNECTED after a short delay.

if WIFI_PROV

config WIFI_PROV_NAME
	string "Device name"
	default "Device"

endif
```
